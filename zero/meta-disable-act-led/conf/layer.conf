## zero/meta-disable-act-led/conf/layer.conf
```bitbake
# We have a conf and classes directory, add to BBPATH
BBPATH .= ":${LAYERDIR}"

# We have recipes-* directories, add to BBFILES
BBFILES += "${LAYERDIR}/recipes-devicetree/linux-raspberrypi_%.bbappend"

BBFILE_COLLECTIONS += "disable-act-led"
BBFILE_PATTERN_disable-act-led = "^${LAYERDIR}/"
BBFILE_PRIORITY_disable-act-led = "6"

LAYERDEPENDS_disable-act-led = "raspberrypi"
LAYERSERIES_COMPAT_disable-act-led = "kirkstone"

KERNEL_DEVICETREE:append = " overlays/disable-act-led.dtbo"
RPI_EXTRA_CONFIG:append = "dtoverlay=disable-act-led\n"
```

## zero/meta-scsat1-cam/conf/layer.conf
```bitbake
# We have a conf and classes directory, add to BBPATH
BBPATH .= ":${LAYERDIR}"

# We have recipes-* directories, add to BBFILES
BBFILES += "${LAYERDIR}/recipes-*/*/*.bb \
            ${LAYERDIR}/recipes-*/*/*.bbappend"

BBFILE_COLLECTIONS += "scsat1-cam"
BBFILE_PATTERN_scsat1-cam = "^${LAYERDIR}/"
BBFILE_PRIORITY_scsat1-cam = "6"

LAYERDEPENDS_scsat1-cam = "core"
LAYERSERIES_COMPAT_scsat1-cam = "kirkstone"

#We need to add the hello software package to the target image 
IMAGE_INSTALL:append = " scsat1-cam"
```
